## target/Config.in
```kconfig
source "tmp/.config-target.in"

# Kernel/Hardware features

config HAS_TESTING_KERNEL
	bool

config HAS_SPE_FPU
	depends on powerpc
	select HAS_FPU
	bool

config HAS_FPU
	bool

config HAS_DT_OVERLAY_SUPPORT
	bool

config AUDIO_SUPPORT
	bool

config GPIO_SUPPORT
	bool

config PCI_SUPPORT
	select AUDIO_SUPPORT
	bool

config PCIE_SUPPORT
	bool

config PCMCIA_SUPPORT
	bool

config PWM_SUPPORT
	bool

config USB_SUPPORT
	select AUDIO_SUPPORT
	bool

config USB_GADGET_SUPPORT
	bool

config RTC_SUPPORT
	bool

config BIG_ENDIAN
	bool

config USES_DEVICETREE
	bool

config USES_INITRAMFS
	bool

config USES_SEPARATE_INITRAMFS
	bool

config USES_SQUASHFS
	bool

config USES_JFFS2
	bool

config USES_JFFS2_NAND
	bool

config USES_EXT4
	bool

config USES_TARGZ
	bool

config USES_CPIOGZ
	bool

config USES_MINOR
	bool

config USES_UBIFS
	bool
	select NAND_SUPPORT

config LOW_MEMORY_FOOTPRINT
	bool

config SMALL_FLASH
	bool

config NOMMU
	bool

config RFKILL_SUPPORT
	bool

config EMMC_SUPPORT
	bool

config NAND_SUPPORT
	bool

config LEGACY_SDCARD_SUPPORT
	bool

config ARCH_64BIT
	bool

config VIRTIO_SUPPORT
	bool

config USES_ROOTFS_PART
	bool

config USES_BOOT_PART
	bool

# Architecture selection

config aarch64
	select ARCH_64BIT
	bool

config aarch64_be
	select ARCH_64BIT
	select BIG_ENDIAN
	bool

config arc
	bool

config arceb
	select BIG_ENDIAN
	bool

config arm
	bool

config armeb
	select BIG_ENDIAN
	bool

config arm_v6
	bool

config arm_v7
	bool

config powerpc
	select BIG_ENDIAN
	bool

config sh3
	bool

config sh3eb
	select BIG_ENDIAN
	bool

config sh4
	bool

config sh4eb
	select BIG_ENDIAN
	bool

config sparc
	select BIG_ENDIAN
	bool

config ARCH
	string
	default "aarch64"   if aarch64
	default "aarch64_be" if aarch64_be
	default "arm"       if arm
	default "armeb"     if armeb
```
